## config/west.yml
```yaml
manifest:
  remotes:
    - name: zmkfirmware
      url-base: https://github.com/zmkfirmware
    - name: songweicn
      url-base: https://github.com/songweicn
  projects:
    - name: zmk
      remote: songweicn
      revision: testbranch
      import: app/west.yml
  self:
    path: config
```
